## Documentation/devicetree/bindings/display/panel/htc,m7ul-panel.yaml
```yaml
# SPDX-License-Identifier: GPL-2.0-only OR BSD-2-Clause
%YAML 1.2
---
$id: http://devicetree.org/schemas/display/panel/htc,m7ul-panel.yaml#
$schema: http://devicetree.org/meta-schemas/core.yaml#

title: HTC One M7 UL JDI/Samsung DSI panel

maintainers:
  - Pascal Garber <pascal@artandcode.studio>

allOf:
  - $ref: panel-common.yaml#

properties:
  compatible:
    const: htc,m7ul-panel

  reg:
    maxItems: 1
    description: DSI virtual channel

  vdd-supply:
    description: 1.2 V panel supply

  vddio-supply:
    description: 1.8 V panel I/O supply

  clocks:
    maxItems: 1
    description: XO_D0 clock pulsed after reset

  clock-names:
    const: xo

  reset-gpios:
    maxItems: 1
    description: Active-low panel reset

  vdd5v-en-gpios:
    maxItems: 1
    description: Active-high positive 5 V boost enable

  vddn5v-en-gpios:
    maxItems: 1
    description: Active-high negative 5 V boost enable

  backlight-gpios:
    maxItems: 1
    description: Active-high backlight enable

  pwm-i2c-bus:
    $ref: /schemas/types/phandle-array.yaml#/items
    description: I2C bus of the backlight PWM controller

  port: true

required:
  - compatible
  - reg
  - vdd-supply
  - vddio-supply
  - clocks
  - clock-names
  - reset-gpios
  - vdd5v-en-gpios
  - vddn5v-en-gpios
  - backlight-gpios
  - port

additionalProperties: false

examples:
  - |
    #include <dt-bindings/clock/qcom,rpmcc.h>
    #include <dt-bindings/gpio/gpio.h>

    dsi {
        #address-cells = <1>;
        #size-cells = <0>;

        panel@0 {
            compatible = "htc,m7ul-panel";
            reg = <0>;
            vdd-supply = <&pm8921_l2>;
            vddio-supply = <&pm8921_lvs5>;
            clocks = <&rpmcc RPM_XO_D0>;
            clock-names = "xo";
            reset-gpios = <&tlmm 31 GPIO_ACTIVE_LOW>;
            vdd5v-en-gpios = <&pm8921_gpio 37 GPIO_ACTIVE_HIGH>;
            vddn5v-en-gpios = <&pm8921_gpio 36 GPIO_ACTIVE_HIGH>;
            backlight-gpios = <&tlmm 86 GPIO_ACTIVE_HIGH>;
            pwm-i2c-bus = <&i2c2>;

            port {
                panel_in: endpoint {
                    remote-endpoint = <&dsi0_out>;
                };
            };
        };
    };
```
